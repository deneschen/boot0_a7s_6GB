/dts-v1/;

/ {
	compatible = "radxa,cubie-a7s-ar100s-hw-config";

	/* Values from cubie_a7s/linux-6.6/board.dts. */
	standby_param {
		vcc-io = <0x00000400>;
		vcc-efuse = <0x0e000000>;
		vdd-cpub = <0x00000004>;
		vdd-cpu = <0x00000010>;
		vdd-sys = <0x00000002>;
		vcc-pll = <0x01000000>;
		osc24m-on = <0>;
	};

	/* boot0 replaces every placeholder with the trained 96-word buffer. */
	dram {
		dram_para00 = <0>;
		dram_para01 = <0>;
		dram_para02 = <0>;
		dram_para03 = <0>;
		dram_para04 = <0>;
		dram_para05 = <0>;
		dram_para06 = <0>;
		dram_para07 = <0>;
		dram_para08 = <0>;
		dram_para09 = <0>;
		dram_para10 = <0>;
		dram_para11 = <0>;
		dram_para12 = <0>;
		dram_para13 = <0>;
		dram_para14 = <0>;
		dram_para15 = <0>;
		dram_para16 = <0>;
		dram_para17 = <0>;
		dram_para18 = <0>;
		dram_para19 = <0>;
		dram_para20 = <0>;
		dram_para21 = <0>;
		dram_para22 = <0>;
		dram_para23 = <0>;
		dram_para24 = <0>;
		dram_para25 = <0>;
		dram_para26 = <0>;
		dram_para27 = <0>;
		dram_para28 = <0>;
		dram_para29 = <0>;
		dram_para30 = <0>;
		dram_para31 = <0>;
		dram_para32 = <0>;
		dram_para33 = <0>;
		dram_para34 = <0>;
		dram_para35 = <0>;
		dram_para36 = <0>;
		dram_para37 = <0>;
		dram_para38 = <0>;
		dram_para39 = <0>;
		dram_para40 = <0>;
		dram_para41 = <0>;
		dram_para42 = <0>;
		dram_para43 = <0>;
		dram_para44 = <0>;
		dram_para45 = <0>;
		dram_para46 = <0>;
		dram_para47 = <0>;
		dram_para48 = <0>;
		dram_para49 = <0>;
		dram_para50 = <0>;
		dram_para51 = <0>;
		dram_para52 = <0>;
		dram_para53 = <0>;
		dram_para54 = <0>;
		dram_para55 = <0>;
		dram_para56 = <0>;
		dram_para57 = <0>;
		dram_para58 = <0>;
		dram_para59 = <0>;
		dram_para60 = <0>;
		dram_para61 = <0>;
		dram_para62 = <0>;
		dram_para63 = <0>;
		dram_para64 = <0>;
		dram_para65 = <0>;
		dram_para66 = <0>;
		dram_para67 = <0>;
		dram_para68 = <0>;
		dram_para69 = <0>;
		dram_para70 = <0>;
		dram_para71 = <0>;
		dram_para72 = <0>;
		dram_para73 = <0>;
		dram_para74 = <0>;
		dram_para75 = <0>;
		dram_para76 = <0>;
		dram_para77 = <0>;
		dram_para78 = <0>;
		dram_para79 = <0>;
		dram_para80 = <0>;
		dram_para81 = <0>;
		dram_para82 = <0>;
		dram_para83 = <0>;
		dram_para84 = <0>;
		dram_para85 = <0>;
		dram_para86 = <0>;
		dram_para87 = <0>;
		dram_para88 = <0>;
		dram_para89 = <0>;
		dram_para90 = <0>;
		dram_para91 = <0>;
		dram_para92 = <0>;
		dram_para93 = <0>;
		dram_para94 = <0>;
		dram_para95 = <0>;
	};
};
