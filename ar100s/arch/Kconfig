## ar100s/arch/Kconfig
```kconfig
config CPUX_ARM64
	bool

config RISCV
	bool

config AR100S_OS
	bool

choice PLATFORM
	prompt "Sunxi-chip to use"
	help
	the ic we use for build

config SUN60IW2P1
	bool
	imply CPUX_ARM64
	select RISCV
	select AR100S_OS
	prompt "AW1903 sun60iw2p1 A733 platform"

endchoice

choice PLATFORM_SELECT
	prompt "Platform used"

config EVB_PLATFORM
	bool "evb platfrom used"

config FPGA_PLATFORM
	bool "fpga platform used"

endchoice

config CHIP_PLATFORM
	string "The name of SUNXI CHIP"
	default "sun60iw2p1" if SUN60IW2P1

config ARCH_PLATFORM
	string "The name of SUNXI ARCH"
	default "riscv" if RISCV
```

## ar100s/driver/dram/Kconfig
```kconfig
#source "driver/dram/dram-sun50iw6p1/Kconfig"

menuconfig DRAMFREQ_USED
	bool
	prompt "DRAM Freq used"

menuconfig DRAM_PARA_EXTEND_USED
	bool
	prompt "DRAM para extend used"
	default n

config DRAM_DTS_PARA_V2
	bool
	prompt "DRAM dts para V2 used"

config HAVE_DDR_SEL_SUPPORT
	bool

config HAVE_DDR3_SUPPORT
	bool

config HAVE_DDR4_SUPPORT
	bool

config HAVE_LRDDR3_SUPPORT
	bool

config HAVE_LRDDR4_SUPPORT
	bool

config DRAM_PARA_V2
	bool
	prompt "DRAM para v2 used"
	default n

choice DDR_TYPE
	prompt  "DDR type used"
	depends on HAVE_DDR_SEL_SUPPORT

	config DDR3
	bool "ddr3"
	depends on HAVE_DDR3_SUPPORT

	config DDR4
	bool "ddr4"
	depends on HAVE_DDR4_SUPPORT

	config LRDDR3
	bool "lpddr3"
	depends on HAVE_LRDDR3_SUPPORT

	config LRDDR4
	bool "lpddr4"
	depends on HAVE_LRDDR4_SUPPORT

endchoice
```

## ar100s/driver/hwmsgbox/Kconfig
```kconfig
config MSGBOX_USED
	def_bool y
	prompt "MSGBOX used"

choice MSGBOX_IP
	prompt "Sunxi msgbox to use"
	depends on MSGBOX_USED

	config HW_MSGBOX_EXTENDED_USED
	bool
	prompt "New IP MSGBOX used"
	depends on MSGBOX_USED
endchoice
```

## ar100s/driver/intc/Kconfig
```kconfig
choice IRQCHIP_IP
	prompt "Sunxi irqchip to use"

config CLIC_USED
	bool
	prompt "clic used"

endchoice
```

## ar100s/driver/pmu/Kconfig
```kconfig
menuconfig PMU_USED
	bool
	prompt "PMU used"
	default y

menuconfig BMU_USED
	bool
	prompt "BMU used"
	default n

if PMU_USED

config AXP8191_USED
	bool "AXP8191 used"

endif # PMU_USED

if BMU_USED

config AXP515_USED
	bool "bmu axp515 used"

endif # BMU_USED
```

## ar100s/service/Kconfig
```kconfig
menu "Services"


config STANDBY_SERVICE
	def_bool y
	prompt "Standby service support"

config FDT_USED
	def_bool y
	prompt "fdt lib support"

config FDT_INIT_ARISC_PMU_USED
	def_bool n
	depends on FDT_USED
	prompt "init arisc pmu from fdt support"

config FDT_INIT_ARISC_UART_USED
	def_bool n
	depends on FDT_USED
	prompt "init arisc uart from fdt support"

endmenu
```
